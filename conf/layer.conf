## conf/layer.conf
```bitbake
# We have a conf and classes directory, append to BBPATH
BBPATH .= ":${LAYERDIR}"

# We have a recipes directory, add to BBFILES
BBFILES += "${LAYERDIR}/recipes*/*/*.bb ${LAYERDIR}/recipes*/*/*.bbappend"

BBFILE_COLLECTIONS += "ocaml-apps-layer"
BBFILE_PATTERN_ocaml-apps-layer := "^${LAYERDIR}/"
BBFILE_PRIORITY_ocaml-apps-layer = "10"

# Custom licenses used by some packages in this layer
LICENSE_PATH += "${LAYERDIR}/files/custom-licenses"

# This should only be incremented on significant changes that will
# cause compatibility issues with other layers
LAYERVERSION_ocaml-apps-layer = "1"

LAYERDEPENDS_ocaml-apps-layer = "core meta-openxt-ocaml-platform"
LAYERSERIES_COMPAT_ocaml-apps-layer = "sumo"

IMAGE_CLASSES += " vhd_image"
```
